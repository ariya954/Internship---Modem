## CMakeLists.txt
```
# SPDX-License-Identifier: Apache-2.0

cmake_minimum_required(VERSION 3.20.0)

set(BOARD_ROOT ${CMAKE_CURRENT_LIST_DIR})

set(BOARD stm32f4_disco)

find_package(Zephyr REQUIRED HINTS $ENV{ZEPHYR_BASE})
project(ESFA_Modem)

target_sources(app PRIVATE src/main.c)
```

## prj.conf
```kconfig
CONFIG_GPIO=y
CONFIG_HWINFO=y

# SPI support
CONFIG_SPI=y
CONFIG_SPI_SLAVE=y
CONFIG_SPI_STM32=y
CONFIG_SPI_STM32_USE_HW_SS=y

# UART support
CONFIG_SERIAL=y
CONFIG_UART_INTERRUPT_DRIVEN=y

# GSM modem support
CONFIG_MODEM=y
CONFIG_MODEM_GSM_PPP=y

# PPP networking support
CONFIG_NET_DRIVERS=y
CONFIG_NET_PPP=y
CONFIG_NET_L2_PPP=y
CONFIG_NET_NATIVE=y
CONFIG_NETWORKING=y

CONFIG_NET_L2_PPP_TIMEOUT=10000

# IPv4 enables PPP IPCP support
CONFIG_NET_IPV4=y
CONFIG_NET_IPV6=n

# Network management events
CONFIG_NET_CONNECTION_MANAGER=y

# Log buffers, modem and PPP
CONFIG_LOG=y
CONFIG_NET_LOG=y
#CONFIG_LOG_BUFFER_SIZE=16384
#CONFIG_MODEM_LOG_LEVEL_DBG=y
#CONFIG_NET_PPP_LOG_LEVEL_DBG=y
#CONFIG_NET_L2_PPP_LOG_LEVEL_DBG=y
#CONFIG_NET_MGMT_EVENT_LOG_LEVEL_DBG=y
#CONFIG_NET_CONNECTION_MANAGER_LOG_LEVEL_DBG=y

CONFIG_NET_SHELL=y
CONFIG_MODEM_SHELL=y
```

## src/main.c
```c
#define RESPONSE_DELAY 1000
#define SLEEP_TIME_MS  1000
#define LED1_NODE     DT_ALIAS(led1)
#define UART_NODE     DT_ALIAS(uart2)
#define SPI_CS        DT_ALIAS(cs)
#define SPI_NODE      DT_ALIAS(spi)
#define spi_act_pin   DT_ALIAS(spiactpin)
#define UART_BUF_SIZE 1500
#define SPI_BUF_SIZE 1024
#define NUM_OF_INPUTS 8
#define NUM_OF_OUTPUTS 8

#include <zephyr/drivers/gpio.h>
#include <zephyr/drivers/modem/gsm_ppp.h>
#include <zephyr/drivers/uart.h>
#include <zephyr/drivers/spi.h>
#include <zephyr/logging/log.h>
#include <zephyr/net/net_conn_mgr.h>
#include <zephyr/net/net_event.h>
#include <zephyr/net/net_mgmt.h>
#include <zephyr/shell/shell.h>
#include <zephyr/sys/printk.h>
#include <zephyr/zephyr.h>
#include <zephyr/device.h>
#include <string.h>
#include "crc32.c"

LOG_MODULE_REGISTER(sample_gsm_ppp, LOG_LEVEL_DBG);

uint32_t crc; 
uint8_t rx_buf_spi[SPI_BUF_SIZE];
char rx_buf_uart[UART_BUF_SIZE];
int rx_buf_uart_pos = 0;

const char END_MESSAGE[] = "\r\n";
const struct device *spi;
const struct device *uart_dev = DEVICE_DT_GET(UART_NODE);
static const struct gpio_dt_spec spi_activate_pin = GPIO_DT_SPEC_GET(spi_act_pin, gpios);
static const struct gpio_dt_spec led1 = GPIO_DT_SPEC_GET(LED1_NODE, gpios);
static const struct device *gsm_dev;
static struct net_mgmt_event_callback mgmt_cb;
static bool starting = IS_ENABLED(CONFIG_GSM_PPP_AUTOSTART);

/* queue to store up to 10 messages (aligned to 4-byte boundary) */
K_MSGQ_DEFINE(uart_msgq, 32, 10, 4);

typedef struct //Measurment
parameters
{
	float dummy;
	
	float voltage_ab;
	float voltage_bc;
	float voltage_ca;
	
	float voltage_a;
	float voltage_b;
	float voltage_c;
	float voltage_avg;

	float current_a;
	float current_b;
	float current_c;
	float current_n;
	float current_avg;
	
	float active_power_a;
	float active_power_b;
	float active_power_c;
	float total_active_power;
	
	float apr_power_a;
	float apr_power_b;
	float apr_power_c;
	float total_apr_power;	
	
	float reactive_power_a;
	float reactive_power_b;
	float reactive_power_c;
	float total_reactive_power;
	
	float power_factor_a;
	float power_factor_b;
	float power_factor_c;
	float total_power_factor;
	float frequency;
	
	uint8_t input[NUM_OF_INPUTS];
	uint8_t inputH2L[NUM_OF_INPUTS];
	uint8_t inputL2H[NUM_OF_INPUTS];
	uint8_t output[NUM_OF_OUTPUTS];
	
	float angle0;
	float angle1;
	float angle2;
	
	float voltage_thd;
	float current_thd;	
	
	uint8_t alarm;
	
	uint8_t energy_reset;
	uint8_t alarm_reset;
		
}Measurment_t;

struct spi_cs_control spi_cs = {
	.gpio = GPIO_DT_SPEC_GET(SPI_CS, gpios),
	.delay = 10
};

struct spi_config spi_cfg = {
	.frequency = 1000000,
	.operation = SPI_OP_MODE_SLAVE | SPI_WORD_SET(8) | SPI_FULL_DUPLEX | SPI_MODE_GET(0) | SPI_TRANSFER_MSB,
	.slave = 1, 
	.cs = &spi_cs
};

struct spi_buf rx_bufs[] = { { .buf = rx_buf_spi, .len = SPI_BUF_SIZE } };

struct spi_buf_set spi_rx_buf = { .buffers = rx_bufs, .count = 1 };

static int cmd_sample_modem_suspend(const struct shell *shell, size_t argc, char *argv[])
{
	ARG_UNUSED(argc);
	ARG_UNUSED(argv);

	if (!starting) {
		shell_fprintf(shell, SHELL_NORMAL, "Modem is already stopped.\n");
		return -ENOEXEC;
	}

	gsm_ppp_stop(gsm_dev);
	starting = false;

	return 0;
}

static int cmd_sample_modem_resume(const struct shell *shell, size_t argc, char *argv[])
{
	ARG_UNUSED(argc);
	ARG_UNUSED(argv);

	if (starting) {
		shell_fprintf(shell, SHELL_NORMAL, "Modem is already started.\n");
		return -ENOEXEC;
	}

	gsm_ppp_start(gsm_dev);
	starting = true;

	return 0;
}

SHELL_STATIC_SUBCMD_SET_CREATE(
	sample_commands, SHELL_CMD(resume, NULL, "Resume the modem\n", cmd_sample_modem_resume),
	SHELL_CMD(suspend, NULL, "Suspend the modem\n", cmd_sample_modem_suspend),
	SHELL_SUBCMD_SET_END);

SHELL_CMD_REGISTER(sample, &sample_commands, "Sample application commands", NULL);

static void event_handler(struct net_mgmt_event_callback *cb, uint32_t mgmt_event,
			  struct net_if *iface)
{
	ARG_UNUSED(cb);
	ARG_UNUSED(iface);

	if ((mgmt_event & (NET_EVENT_L4_CONNECTED | NET_EVENT_L4_DISCONNECTED)) != mgmt_event) {
		return;
	}

	if (mgmt_event == NET_EVENT_L4_CONNECTED) {
		LOG_INF("Network connected");
		return;
	}

	if (mgmt_event == NET_EVENT_L4_DISCONNECTED) {
		LOG_INF("Network disconnected");
		return;
	}
}

static void modem_on_cb(const struct device *dev, void *user_data)
{
	ARG_UNUSED(dev);
	ARG_UNUSED(user_data);

	LOG_INF("GSM modem on callback fired");
}

static void modem_off_cb(const struct device *dev, void *user_data)
{
	ARG_UNUSED(dev);
	ARG_UNUSED(user_data);

	LOG_INF("GSM modem off callback fired");
}

void gsm_init()
{
	gsm_dev = DEVICE_DT_GET(DT_INST(0, zephyr_gsm_ppp));

	/* Optional register modem power callbacks */
	gsm_ppp_register_modem_power_callback(gsm_dev, modem_on_cb, modem_off_cb, NULL);

	LOG_INF("Board '%s' APN '%s' UART '%s' device %p (%s)", CONFIG_BOARD, CONFIG_MODEM_GSM_APN,
		uart_dev->name, uart_dev, gsm_dev->name);

	net_mgmt_init_event_callback(&mgmt_cb, event_handler,
				     NET_EVENT_L4_CONNECTED | NET_EVENT_L4_DISCONNECTED);
	net_mgmt_add_event_callback(&mgmt_cb);
}

void mdm_cmd_recv_cb(const struct device *uart_dev)
{
	uint8_t c;

	if (!uart_irq_update(uart_dev)) {
		return;
	}

	while (uart_irq_rx_ready(uart_dev)) {

		uart_fifo_read(uart_dev, &c, 1);
	
		if (rx_buf_uart_pos < (sizeof(rx_buf_uart) - 1))
			rx_buf_uart[rx_buf_uart_pos++] = c;
		/* else: characters beyond buffer size are dropped */
	}
	
	k_msgq_put(&uart_msgq, &rx_buf_uart, K_NO_WAIT);

	return;

}

void send_modem(uint8_t *command)
{
	size_t size_of_command = strlen(command);
	
	for (int i = 0; i < size_of_command; i++)
		uart_poll_out(uart_dev, command[i]);
}

void receive_response()
{
	k_msgq_get(&uart_msgq, &rx_buf_uart, K_FOREVER);
	k_msleep(RESPONSE_DELAY);
	rx_buf_uart_pos = 0;
	for(int i = 0; i < sizeof(rx_buf_uart); i++)
		rx_buf_uart[i] = 0;
}

void tcp_init(char *server_address, char *server_port)
{
        //Reset Modem to avoid conflict:
	send_modem("AT+CFUN=1,0");
	send_modem(END_MESSAGE);
	receive_response();
		
	send_modem("AT&F0");
	send_modem(END_MESSAGE);
	receive_response();

	send_modem("ATE0");
	send_modem(END_MESSAGE);
	receive_response();	

	send_modem("AT+QICLOSE=0");
	send_modem(END_MESSAGE);
	receive_response();
	
	send_modem("AT+QIDEACT=1");
	send_modem(END_MESSAGE);
	receive_response();
	
	send_modem("AT+QICSGP=1,1,\"mtnirancell\",\"\",\"\",0");
	send_modem(END_MESSAGE);
	receive_response();	

	send_modem("AT+QIACT=1");
	send_modem(END_MESSAGE);
	receive_response();
			
	send_modem("AT+QIOPEN=1,0,\"TCP\",\"");	
	send_modem(server_address);
	send_modem("\",");
	send_modem(server_port);
	send_modem(",0,0");			
	send_modem(END_MESSAGE);
	receive_response();	

	send_modem("AT+QURCCFG=\"urcport\",\"uart1\"");
	send_modem(END_MESSAGE);
	receive_response();
	
	send_modem("AT+QISWTMD=0,0");
	send_modem(END_MESSAGE);
	receive_response();
}

void tcp_send(char *send_massage)
{
	send_modem("AT+QISEND=0");
	send_modem(END_MESSAGE);
	receive_response();	
	
	char ctrl_Z = 26; 
	send_modem(send_massage);
	send_modem("\n");
	send_modem(&ctrl_Z);
	send_modem(END_MESSAGE);
	receive_response();
}

void tcp_receive()
{
	//1500 is max length of receiving data
	send_modem("AT+QIRD=0,1500");
	send_modem(END_MESSAGE);
	receive_response();
}

void uart_init()
{
	uart_irq_callback_user_data_set(uart_dev, mdm_cmd_recv_cb, NULL);
	uart_irq_rx_enable(uart_dev);	
}

void spi_init()
{
	spi = DEVICE_DT_GET(SPI_NODE); 
}

void spi_activate()
{
	gpio_pin_configure_dt(&spi_activate_pin, GPIO_OUTPUT_ACTIVE);
	gpio_pin_set_dt(&spi_activate_pin, GPIO_ACTIVE_HIGH);
}
int a;
int main(void)
{
		
//starting uart communication:
	uart_init();
	
//starting spi communication between modem's MCU and main MCU:
	spi_init();
	spi_activate();
	
//starting gsm-modem:
	gsm_init();

	//spi_irq_callback_user_data_set(spi, spi_receive_cb, NULL);
	a = gpio_pin_get_dt(&spi_activate_pin);
	
	//uart_irq_rx_enable(spi);
	//spi_receive();	
	
	int ret = gpio_pin_configure_dt(&led1, GPIO_OUTPUT_ACTIVE);
		
	//tcp_init("postman-echo.com", "80");			
	
	//tcp_init("tcpbin.com", "4242");
	
	//tcp_init("smtp.gmail.com", "465");
	
	tcp_init("google.com", "80");
	
	tcp_send("test1");	
	tcp_receive();
	tcp_receive();
	
	tcp_init("google.com", "80");
	
	tcp_send("test2");	
	tcp_receive();
	tcp_receive();
	
	tcp_init("google.com", "80");
	
	tcp_send("test3");	
	tcp_receive();
	tcp_receive();
	
	tcp_init("google.com", "80");
	
	tcp_send("test4");	
	tcp_receive();
	tcp_receive();
	
	tcp_init("google.com", "80");
	
	tcp_send("test5");	
	tcp_receive();
	tcp_receive();
									
/*	mdm_cmd_send(uart_dev, "AT+QMTCFG=\"aliauth\",1\r\n", strlen("AT+QMTCFG=\"aliauth\",1\r\n"));
	mdm_cmd_recv();
	
	mdm_cmd_send(uart_dev, "AT+QMTCFG=\"version\",0,4\r\n", strlen("AT+QMTCFG=\"version\",0,4\r\n"));
	mdm_cmd_recv();	
	
	mdm_cmd_send(uart_dev, "AT+QMTCFG=\"recv/mode\",0,0,1\r\n", strlen("AT+QMTCFG=\"recv/mode\",0,0,1\r\n"));
	mdm_cmd_recv();	
	
	mdm_cmd_send(uart_dev, "AT+QMTOPEN=0,\"broker.hivemq.com\",1883\r\n", strlen("AT+QMTOPEN=0,\"broker.hivemq.com\",1883\r\n"));
	mdm_cmd_recv();	

	mdm_cmd_send(uart_dev, "AT+QMTCONN=0,\"1947\"\r\n", strlen("AT+QMTCONN=0,\"1947\"\r\n"));
	mdm_cmd_recv();			
	
/*
	ARG_UNUSED(gsm_dev);
	gsm_ppp_stop(gsm_dev);
*/
	Measurment_t measurment;
	while (true) {
/*		ARG_UNUSED(gsm_dev);
		gsm_ppp_start(gsm_dev);
*/		ret = gpio_pin_toggle_dt(&led1);
		k_msleep(SLEEP_TIME_MS);
		a = spi_transceive(spi, &spi_cfg, NULL, &spi_rx_buf);
	        crc = ~(crc_32(rx_buf_spi, 1020));		
		memcpy(&measurment, &rx_buf_spi, sizeof(Measurment_t));
/*		ARG_UNUSED(gsm_dev);
		gsm_ppp_stop(gsm_dev);
*/	}
	return 0;
}
```

## src/checksum.h
```c
/*
 * Library: libcrc
 * File:    include/checksum.h
 * Author:  Lammert Bies
 *
 * This file is licensed under the MIT License as stated below
 *
 * Copyright (c) 1999-2016 Lammert Bies
 *
 * Permission is hereby granted, free of charge, to any person obtaining a copy
 * of this software and associated documentation files (the "Software"), to deal
 * in the Software without restriction, including without limitation the rights
 * to use, copy, modify, merge, publish, distribute, sublicense, and/or sell
 * copies of the Software, and to permit persons to whom the Software is
 * furnished to do so, subject to the following conditions:
 *
 * The above copyright notice and this permission notice shall be included in all
 * copies or substantial portions of the Software.
 * 
 * THE SOFTWARE IS PROVIDED "AS IS", WITHOUT WARRANTY OF ANY KIND, EXPRESS OR
 * IMPLIED, INCLUDING BUT NOT LIMITED TO THE WARRANTIES OF MERCHANTABILITY,
 * FITNESS FOR A PARTICULAR PURPOSE AND NONINFRINGEMENT. IN NO EVENT SHALL THE
 * AUTHORS OR COPYRIGHT HOLDERS BE LIABLE FOR ANY CLAIM, DAMAGES OR OTHER
 * LIABILITY, WHETHER IN AN ACTION OF CONTRACT, TORT OR OTHERWISE, ARISING FROM,
 * OUT OF OR IN CONNECTION WITH THE SOFTWARE OR THE USE OR OTHER DEALINGS IN THE
 * SOFTWARE.
 *
 * Description
 * -----------
 * The headerfile include/checksum.h contains the definitions and prototypes
 * for routines that can be used to calculate several kinds of checksums.
 */

#ifndef DEF_LIBCRC_CHECKSUM_H
#define DEF_LIBCRC_CHECKSUM_H

#ifdef __cplusplus
extern "C" {
#endif

#include <stdint.h>

/*
 * #define CRC_POLY_xxxx
 *
 * The constants of the form CRC_POLY_xxxx define the polynomials for some well
 * known CRC calculations.
 */

#define		CRC_POLY_16		0xA001
#define		CRC_POLY_32		0xEDB88320L
#define		CRC_POLY_CCITT		0x1021
#define		CRC_POLY_DNP		0xA6BC
#define		CRC_POLY_KERMIT		0x8408
#define		CRC_POLY_SICK		0x8005

/*
 * #define CRC_START_xxxx
 *
 * The constants of the form CRC_START_xxxx define the values that are used for
 * initialization of a CRC value for common used calculation methods.
 */

#define		CRC_START_8		0x00
#define		CRC_START_16		0x0000
#define		CRC_START_MODBUS	0xFFFF
#define		CRC_START_XMODEM	0x0000
#define		CRC_START_CCITT_1D0F	0x1D0F
#define		CRC_START_CCITT_FFFF	0xFFFF
#define		CRC_START_KERMIT	0x0000
#define		CRC_START_SICK		0x0000
#define		CRC_START_DNP		0x0000
#define		CRC_START_32		0xFFFFFFFFL

/*
 * Prototype list of global functions
 */

unsigned char *		checksum_NMEA(     const unsigned char *input_str, unsigned char *result  );
uint8_t			crc_8(             const unsigned char *input_str, size_t num_bytes       );
uint16_t		crc_16(            const unsigned char *input_str, size_t num_bytes       );
uint32_t		crc_32(            const unsigned char *input_str, size_t num_bytes       );
uint16_t		crc_ccitt_1d0f(    const unsigned char *input_str, size_t num_bytes       );
uint16_t		crc_ccitt_ffff(    const unsigned char *input_str, size_t num_bytes       );
uint16_t		crc_dnp(           const unsigned char *input_str, size_t num_bytes       );
uint16_t		crc_kermit(        const unsigned char *input_str, size_t num_bytes       );
uint16_t		crc_modbus(        const unsigned char *input_str, size_t num_bytes       );
uint16_t		crc_sick(          const unsigned char *input_str, size_t num_bytes       );
uint16_t		crc_xmodem(        const unsigned char *input_str, size_t num_bytes       );
uint8_t			update_crc_8(      uint8_t  crc, unsigned char c                          );
uint16_t		update_crc_16(     uint16_t crc, unsigned char c                          );
uint32_t		update_crc_32(     uint32_t crc, unsigned char c                          );
uint16_t		update_crc_ccitt(  uint16_t crc, unsigned char c                          );
uint16_t		update_crc_dnp(    uint16_t crc, unsigned char c                          );
uint16_t		update_crc_kermit( uint16_t crc, unsigned char c                          );
uint16_t		update_crc_sick(   uint16_t crc, unsigned char c, unsigned char prev_byte );

#ifdef __cplusplus
}
#endif
#endif  // DEF_LIBCRC_CHECKSUM_H
```
